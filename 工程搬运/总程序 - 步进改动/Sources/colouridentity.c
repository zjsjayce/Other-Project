#include <hidef.h>      /* common defines and macros */
#include "derivative.h"      /* derivative-specific definitions */
#include <mc9s12xs128.h>

#define uchar unsigned int
#define uint unsigned int
//=====================================================================================================================
//=============================================S2接B2,S3接B0===========================================================
//=====================================================================================================================
#define S3 PORTA_PA6
#define S2 PORTA_PA4
//=====================================================================================================================
//=================================================总线时钟为80MHz=====================================================
//===================================================================================================================== 
unsigned char flag,flag2,i,count;
double a,b;
//=====================================================================================================================
//===============================================颜色传感器初始化函数==================================================
//=====================================================================================================================
void colour_init()                                     
{
    TIOS_IOS1=0;//0通道设置为输入捕捉//TIOS_IOS2=0;//通道2设置为输入捕捉    
    TSCR2_TOI=1;//允许定时器溢出中断
    TSCR2_PR=4;//BUSCLOCK/16  总线时钟80MHz，分频为5MHz
    TCTL3=0x00;
    TCTL4=0x04;//通道0设置为捕捉上升沿信号 通道2为下降沿
    TIE_C1I=1;//允许0通道中断// TIE_C2I=1;//允许2通道中断   
    TFLG1=0xff;//清除中断标志位
    TFLG2=0xff;//清除中断标志位   
}
//=====================================================================================================================
//=================================================三原色光强值返回函数======================================================
//=====================================================================================================================
uchar green()                         /************绿色************/
{   
    uchar num;
    S2=1;S3=1; 
    TSCR1_TEN=1;//打开主定时器
    flag2=1;
    while(flag2);
    TSCR1_TEN=0;//关闭主定时器
    num=(1/((count*65535+b-a)/500000000))/1000;
    return num;
    
}
uchar red()                           /************红色************/
{   
    uchar num;
    S2=0;S3=0;
    TSCR1_TEN=1;//打开主定时器
    flag2=1;
    while(flag2);
    TSCR1_TEN=0;//关闭主定时器
    num=(1/((count*65535+b-a)/500000000))/1000;
    return num;
}
uchar blue()                          /************蓝色************/
{
    uchar num;
    S2=0;S3=1;
    TSCR1_TEN=1;//打开主定时器
    flag2=1;
    while(flag2);
    TSCR1_TEN=0;//关闭主定时器
    num=(1/((count*65535+b-a)/500000000))/1000;
    return num;
}
uchar colour_identity() 
{
    uchar yanse_table[3],yanse=0;
    yanse_table[0]=green();
    yanse_table[1]=red();
    yanse_table[2]=blue();
    if(yanse_table[0]<=8&&yanse_table[1]<=8&&yanse_table[2]<=8) 
    {
        yanse=4;
    } 
    else if(yanse_table[0]>=30&&yanse_table[1]>=30&&yanse_table[2]>=30) 
    {
        yanse=2;
    }
    else if(yanse_table[1]>=yanse_table[0]&&yanse_table[1]>=yanse_table[2]) 
    {
        yanse=3;
    }
    else if(yanse_table[0]>=yanse_table[1]&&yanse_table[0]>=yanse_table[2]) 
    {
        yanse=1;
    }
    else if(yanse_table[2]>=yanse_table[1]&&yanse_table[2]>=yanse_table[0]) 
    {
        yanse=5;
    }
      
    return yanse;      
}

//======================================================================================================================
//====================================================输入捕捉中断函数==================================================
//======================================================================================================================
#pragma CODE_SEG __NEAR_SEG NON_BANKED
void interrupt 16 TOF()                 /************定时器中断函数************/
{
    TFLG2_TOF=1;
    count++;
}

void interrupt 9  IC_1()                /*************通道中断函数************/
{
    TFLG1_C1F=1;
    if(flag==0) 
    { 
        count=0;
        a=TC1;
        flag=1;
    } 
    else if(flag==1)
    {                
      i++;  
      if(i==100) 
      {
          i=0 ;
          b=TC1;                      
          flag=0;
          flag2=0;
      }
    }   
}